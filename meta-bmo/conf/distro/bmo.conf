## meta-bmo/conf/distro/bmo.conf
```bitbake
require conf/distro/poky.conf

DISTRO = "bmo"
DISTRO_NAME = "bmo (Test Distro)"
MAINTAINER = "Youssef <yousseflkashef000@gmail.com>"

DISTRO_FEATURES:append = " systemd usrmerge pam opengl rauc"

IMAGE_FEATURES:append = " splash hwcodecs ssh-server-dropbear"

VIRTUAL-RUNTIME_init_manager = "systemd"
VIRTUAL-RUNTIME_initscripts = ""

DISTRO_FEATURES_BACKFILL += " sysvinit"


LICENSE_FLAGS_ACCEPTED = "synaptics-killswitch"
```

## meta-bmo/wic/bmo-image.wks
```
bootloader --ptable msdos
part /boot --ondisk mmcblk0 --source bootimg-partition --fstype=vfat --label boot --active --align 4 --size 128
part /     --ondisk mmcblk0 --source rootfs --fstype=ext4 --label rootfs_a --align 4 --size 2000
part /     --ondisk mmcblk0 --source rootfs --fstype=ext4 --label rootfs_b --align 4 --size 2000
```
